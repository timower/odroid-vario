## conf/bblayers.conf.sample
```bitbake
# POKY_BBLAYERS_CONF_VERSION is increased each time build/conf/bblayers.conf
# changes incompatibly
POKY_BBLAYERS_CONF_VERSION = "2"

BBPATH = "${TOPDIR}"
BBFILES ?= ""

BBLAYERS ?= " \
  ##OEROOT##/../openembedded-core/meta \
  ##OEROOT##/../meta-meson \
  ##OEROOT##/../meta-mender/meta-mender-core \
  ##OEROOT##/../meta-mender-community/meta-mender-amlogic \
  ##OEROOT##/../meta-vario \
  ##OEROOT##/../meta-openembedded/meta-oe \
  "
```

## conf/distro/vario.conf
```bitbake
DISTRO = "vario"
DISTRO_NAME = "Vario (XCSoar systemd distro)"
DISTRO_VERSION = "4.0.4"
DISTRO_CODENAME = "vario-kirkstone"
SDK_VENDOR = "-variosdk"
SDK_VERSION = "${@d.getVar('DISTRO_VERSION').replace('snapshot-${METADATA_REVISION}', 'snapshot')}"
SDK_VERSION[vardepvalue] = "${SDK_VERSION}"

MAINTAINER = "Timothy Werquin"

TARGET_VENDOR = "-vario"

LOCALCONF_VERSION = "2"

# Override these in poky based distros
POKY_DEFAULT_DISTRO_FEATURES = "largefile opengl"
POKY_DEFAULT_EXTRA_RDEPENDS = "packagegroup-core-boot"
POKY_DEFAULT_EXTRA_RRECOMMENDS = "kernel-module-af-packet"

DISTRO_FEATURES ?= "${DISTRO_FEATURES_DEFAULT} ${POKY_DEFAULT_DISTRO_FEATURES}"

PREFERRED_VERSION_linux-yocto ?= "5.15%"
PREFERRED_VERSION_linux-yocto-rt ?= "5.15%"

SDK_NAME = "${DISTRO}-${TCLIBC}-${SDKMACHINE}-${IMAGE_BASENAME}-${TUNE_PKGARCH}-${MACHINE}"
SDKPATHINSTALL = "/opt/${DISTRO}/${SDK_VERSION}"

DISTRO_EXTRA_RDEPENDS += "${POKY_DEFAULT_EXTRA_RDEPENDS}"
DISTRO_EXTRA_RRECOMMENDS += "${POKY_DEFAULT_EXTRA_RRECOMMENDS}"

TCLIBCAPPEND = ""


require conf/distro/include/no-static-libs.inc
require conf/distro/include/yocto-uninative.inc
require conf/distro/include/security_flags.inc
INHERIT += "uninative"

BB_SIGNATURE_HANDLER ?= "OEEquivHash"
BB_HASHSERVE ??= "auto"

INIT_MANAGER ?= "systemd"
```

## meta-vario/conf/layer.conf
```bitbake
# We have a conf and classes directory, add to BBPATH
BBPATH .= ":${LAYERDIR}"

# We have recipes-* directories, add to BBFILES
BBFILES += "${LAYERDIR}/recipes-*/*/*.bb \
            ${LAYERDIR}/recipes-*/*/*.bbappend"

BBFILE_COLLECTIONS += "meta-vario"
BBFILE_PATTERN_meta-vario = "^${LAYERDIR}/"
BBFILE_PRIORITY_meta-vario = "20"

LAYERDEPENDS_meta-vario = "core"
LAYERSERIES_COMPAT_meta-vario = "kirkstone"
```

## meta-vario/conf/machine/vario-odroidc4.conf
```bitbake
require conf/machine/hardkernel-odroidc4.conf

# Linux MMC ordering is:
# 0: SDCard
# 1: eMMC
# 2: SDIO
# Set the correct value depeding on the boot target:
# /dev/mmcblk0 for SDCard
# /dev/mmcblk1 for eMMC
MENDER_STORAGE_DEVICE = "/dev/mmcblk0"
MENDER_UBOOT_STORAGE_INTERFACE = "mmc"

# U-boot MMC ordering depends if board has SDIO wifi module enabled.
# If yes (like khadas-vim1/2/3):
# 0: SDIO
# 1: SDCard
# 2: eMMC
# If not (like libretech-cc, libretech-ac, odroid-c2, odroid-n2, odroid-c4...)
# 0: SDCard
# 1: eMMC
MENDER_UBOOT_STORAGE_DEVICE = "0"

# mender-image uses sdimg so remove wic image type
IMAGE_FSTYPES:remove = "wic"
# the sdimg-meson class will copy the bootloader in the first sector
IMAGE_CLASSES = "sdimg-meson"

# Use fitImage
KERNEL_IMAGETYPE = "fitImage"

# Remove kernel Image from BOOT partition and disable it
IMAGE_BOOT_FILES:remove = "Image"
IMAGE_BOOT_FILES:remove = "fitImage"
MENDER_BOOT_PART_SIZE_MB = "0"

# 4MiB partition aligment
MENDER_PARTITION_ALIGNMENT = "4194304"
# 4MiB reserved storage before env for bootloader
MENDER_UBOOT_ENV_STORAGE_DEVICE_OFFSET = "4194304"
# 8MiB reserved space for bootloader data = 2*MENDER_PARTITION_ALIGNMENT
MENDER_RESERVED_SPACE_BOOTLOADER_DATA = "8388608"

# Mender config:
MENDER_STORAGE_TOTAL_SIZE_MB = "1536"
```
